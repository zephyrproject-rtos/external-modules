## west.yml
```yaml
# Copyright (c) 2021 Nordic Semiconductor ASA
# SPDX-License-Identifier: Apache-2.0

manifest:
  self:
    west-commands: scripts/west-commands.yml

  remotes:
    - name: zephyrproject-rtos
      url-base: https://github.com/zephyrproject-rtos

  projects:
    - name: zephyr
      remote: zephyrproject-rtos
      revision: main
      import: true
    - name: canopennode
      revision: dec12fa3f0d790cafa8414a4c2930ea71ab72ffd
      path: modules/lib/canopennode
      remote: zephyrproject-rtos
      groups:
        - external
    - name: chre
      revision: 3b32c76efee705af146124fb4190f71be5a4e36e
      path: modules/lib/chre
      remote: zephyrproject-rtos
      groups:
        - external
    - name: lz4
      revision: 11b8a1e22fa651b524494e55d22b69d3d9cebcfd
      path: modules/lib/lz4
      remote: zephyrproject-rtos
      groups:
        - external
    - name: nanopb
      revision: 7307ce399b81ddcb3c3a5dc862c52d4754328d38
      path: modules/lib/nanopb
      remote: zephyrproject-rtos
      groups:
        - external
    - name: psa-arch-tests
      revision: 2cadb02a72eacda7042505dcbdd492371e8ce024
      path: modules/tee/tf-m/psa-arch-tests
      remote: zephyrproject-rtos
      groups:
        - external
    - name: sof
      revision: bc08c9c606324cfba0c104f4ffaf5dd456cb11d6
      path: modules/audio/sof
      remote: zephyrproject-rtos
      groups:
        - external
    - name: tf-m-tests
      revision: c712761dd5391bf3f38033643d28a736cae89a19
      path: modules/tee/tf-m/tf-m-tests
      remote: zephyrproject-rtos
      groups:
        - external
    - name: tflite-micro
      revision: 8d404de73acf7687831e16d88e86e4f73cfddf8e
      path: external/modules/lib/tflite-micro
      repo-path: tflite-micro
      remote: zephyrproject-rtos
      groups:
        - external
    - name: thrift
      path: external/modules/lib/thrift
      revision: 10023645a0e6cb7ce23fcd7fd3dbac9f18df6234
      remote: zephyrproject-rtos
      groups:
        - external
    - name: zephyr-lang-rust
      revision: 615b2b76f18427f7fa6ec2bf765aeed1994dc64e
      path: modules/lang/rust
      remote: zephyrproject-rtos
      groups:
        - external
    - name: zscilib
      path: modules/lib/zscilib
      revision: ee3c0c405087e331aad16d167b6e4ec1c3452ba9
      remote: zephyrproject-rtos
      groups:
        - external
```
